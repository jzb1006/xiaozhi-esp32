## sdkconfig.defaults.muselab-nanoesp32-c6-pdm
```kconfig
CONFIG_BOARD_TYPE_MUSELAB_NANOESP32_C6_PDM=y
CONFIG_OTA_URL="http://203.195.202.54:8766/api/ota/check"
# CONFIG_WAKE_WORD_DISABLED is not set
CONFIG_USE_ESP_WAKE_WORD=y
```
